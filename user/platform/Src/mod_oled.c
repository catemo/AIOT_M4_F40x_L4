/**
 ******************************************************************************
 * @file    mod_oled.c
 * @brief   平台层（platform）—— SSD1306 OLED 器件驱动实现（2.9 新增）
 *
 *  接口的完整说明（功能/参数/返回值/调用处/注意事项）写在 mod_oled.h，
 *  本文件的注释侧重"每一帧 I2C 事务是怎么组织的"。
 *
 *  ▍一帧事务的样子（SSD1306 的 I2C 格式）：
 *      START | 0x78(从机地址+写) | 0x00(后面是命令) 或 0x40(后面是数据) | 载荷 | STOP
 *    命令事务与数据事务的唯一差别就是控制字节：0x00 与 0x40。
 *
 *  ▍本层不认识"文字"：它只把字节写进显存。
 *    拼字符串、四个行位、互斥锁都在应用层 app_oled.c。
 ******************************************************************************
 */
#include "module_cfg.h"
#if MOD_OLED_ENABLE

#include "mod_oled.h"
#include "net_i2c_sw.h"   /* 网络层：起始 / 停止 / 写字节（本层不碰任何引脚） */
#include "main.h"         /* HAL_Delay（等电荷泵稳定） */

/* ========== 内部：一帧命令 / 一帧数据 ========== */

static void oled_write_cmd(uint8_t cmd)
{
    NET_I2CSW_Start();
    NET_I2CSW_WriteByte(MOD_OLED_I2C_ADDR_WRITE);
    NET_I2CSW_WriteByte(0x00U);   /* Co = 0, D/C# = 0 → 后续字节是命令 */
    NET_I2CSW_WriteByte(cmd);
    NET_I2CSW_Stop();
}

static void oled_write_data(uint8_t data)
{
    NET_I2CSW_Start();
    NET_I2CSW_WriteByte(MOD_OLED_I2C_ADDR_WRITE);
    NET_I2CSW_WriteByte(0x40U);   /* Co = 0, D/C# = 1 → 后续字节是显存数据 */
    NET_I2CSW_WriteByte(data);
    NET_I2CSW_Stop();
}

/* ========== 6x8 ASCII 字库（0x20~0x7E，列优先，每字符 6 字节） ==========
 * 每字节 = 纵向 8 个像素（bit0 在上、bit7 在下）。
 * 这张表同时是 8x16 大字的唯一来源：大字由它实时放大，不另维护字模。 */
static const uint8_t s_font6x8[][6] = {
    {0x00,0x00,0x00,0x00,0x00,0x00}, /* ' ' */
    {0x00,0x00,0x5F,0x00,0x00,0x00}, /* '!' */
    {0x00,0x07,0x00,0x07,0x00,0x00}, /* '"' */
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    {0x10,0x08,0x08,0x10,0x08,0x00}, /* '~' */
};

#define FONT_START_CHAR 0x20U   /* 字库起始字符（空格） */
#define FONT_CHAR_COUNT 95U     /* 0x20 ~ 0x7E 共 95 个 */

/* 取字模指针：不可打印字符一律按空格处理（不报错、不留白洞） */
static const uint8_t *oled_get_glyph(char ch)
{
    if ((uint8_t)ch < FONT_START_CHAR || (uint8_t)ch > 0x7EU)
    {
        ch = ' ';
    }
    return s_font6x8[(uint8_t)ch - FONT_START_CHAR];
}

/* ========== 对外接口 ========== */

void MOD_OLED_Init(void)
{
    /* 引脚与总线空闲态由 NET_I2CSW_Init() 负责，这里只发器件初始化序列 */
    NET_I2CSW_Init();

    oled_write_cmd(0xAEU);                        /* 关显示（配置期间先熄屏） */
    oled_write_cmd(0x20U); oled_write_cmd(0x02U); /* 页寻址模式 */
    oled_write_cmd(0xB0U);                        /* 页地址 0 */
    oled_write_cmd(0xC8U);                        /* COM 扫描：下→上（适配中景园） */
    oled_write_cmd(0x00U);                        /* 列地址低 4 位 = 0 */
    oled_write_cmd(0x10U);                        /* 列地址高 4 位 = 0 */
    oled_write_cmd(0x40U);                        /* 显示起始行 0 */
    oled_write_cmd(0x81U); oled_write_cmd(0x7FU); /* 对比度 127 */
    oled_write_cmd(0xA1U);                        /* 段重映射：水平翻转（适配中景园） */
    oled_write_cmd(0xA6U);                        /* 正常显示（非反色） */
    oled_write_cmd(0xA8U); oled_write_cmd(0x3FU); /* 复用率 1/64（64 行） */
    oled_write_cmd(0xA4U);                        /* 跟随 GDDRAM 显示 */
    oled_write_cmd(0xD3U); oled_write_cmd(0x00U); /* 显示偏移 0 */
    oled_write_cmd(0xD5U); oled_write_cmd(0xF0U); /* 时钟分频 */
    oled_write_cmd(0xD9U); oled_write_cmd(0x22U); /* 预充电周期 */
    oled_write_cmd(0xDAU); oled_write_cmd(0x12U); /* COM 引脚配置：Alternative */
    oled_write_cmd(0xDBU); oled_write_cmd(0x20U); /* VCOM 电平 0.77 × Vcc */
    oled_write_cmd(0x8DU); oled_write_cmd(0x14U); /* ★ 电荷泵使能（屏亮不亮的生死线） */
    HAL_Delay(100U);                              /* 等电荷泵稳定 */
    oled_write_cmd(0xAFU);                        /* ★ 开显示 */

    MOD_OLED_Clear();
}

void MOD_OLED_SetCursor(uint8_t page, uint8_t col)
{
    if (page >= MOD_OLED_PAGES) { page = MOD_OLED_PAGES - 1U; }
    if (col >= MOD_OLED_WIDTH)  { col = MOD_OLED_WIDTH - 1U; }

    oled_write_cmd((uint8_t)(0xB0U + page));                 /* 页地址 */
    oled_write_cmd((uint8_t)(0x00U + (col & 0x0FU)));        /* 列地址低 4 位 */
    oled_write_cmd((uint8_t)(0x10U + ((col >> 4) & 0x0FU))); /* 列地址高 4 位 */
}

void MOD_OLED_Fill(uint8_t data)
{
    uint8_t page;
    uint8_t col;

    for (page = 0U; page < MOD_OLED_PAGES; page++)
    {
        MOD_OLED_SetCursor(page, 0U);
        for (col = 0U; col < MOD_OLED_WIDTH; col++)
        {
            oled_write_data(data);
        }
    }
}

void MOD_OLED_Clear(void)
{
    MOD_OLED_Fill(0x00U);
}

void MOD_OLED_ShowChar(uint8_t page, uint8_t col, char ch)
{
    const uint8_t *glyph = oled_get_glyph(ch);
    uint8_t i;

    MOD_OLED_SetCursor(page, col);
    for (i = 0U; i < MOD_OLED_FONT6_WIDTH; i++)
    {
        oled_write_data(glyph[i]);
    }
}

void MOD_OLED_ShowString(uint8_t page, uint8_t col, const char *str)
{
    if (str == NULL)
    {
        return;
    }
    while ((*str != '\0') && (col < MOD_OLED_WIDTH))
    {
        MOD_OLED_ShowChar(page, col, *str);
        col = (uint8_t)(col + MOD_OLED_FONT6_WIDTH);
        str++;
    }
}

void MOD_OLED_ShowChar8x16(uint8_t page, uint8_t col, char ch)
{
    const uint8_t *glyph = oled_get_glyph(ch);
    uint8_t buf[MOD_OLED_FONT8_WIDTH];
    uint8_t i;
    uint8_t j;

    /* 上半页：源字节低 4 位 → 每像素纵向复制 2 次；左右各补 1 列空白 */
    buf[0] = 0x00U;
    for (i = 0U; i < MOD_OLED_FONT6_WIDTH; i++)
    {
        uint8_t src = glyph[i];
        uint8_t dst = 0U;

        for (j = 0U; j < 4U; j++)
        {
            if ((src & (uint8_t)(1U << j)) != 0U)
            {
                dst |= (uint8_t)(3U << (j * 2U));   /* 相邻 2 位都置 1 = 纵向放大 2 倍 */
            }
        }
        buf[i + 1U] = dst;
    }
    buf[MOD_OLED_FONT8_WIDTH - 1U] = 0x00U;

    MOD_OLED_SetCursor(page, col);
    for (i = 0U; i < MOD_OLED_FONT8_WIDTH; i++)
    {
        oled_write_data(buf[i]);
    }

    /* 下半页：源字节高 4 位 → 同一套放大规则，写到 page + 1 */
    buf[0] = 0x00U;
    for (i = 0U; i < MOD_OLED_FONT6_WIDTH; i++)
    {
        uint8_t src = glyph[i];
        uint8_t dst = 0U;

        for (j = 0U; j < 4U; j++)
        {
            if ((src & (uint8_t)(1U << (j + 4U))) != 0U)
            {
                dst |= (uint8_t)(3U << (j * 2U));
            }
        }
        buf[i + 1U] = dst;
    }
    buf[MOD_OLED_FONT8_WIDTH - 1U] = 0x00U;

    MOD_OLED_SetCursor((uint8_t)(page + 1U), col);
    for (i = 0U; i < MOD_OLED_FONT8_WIDTH; i++)
    {
        oled_write_data(buf[i]);
    }
}

void MOD_OLED_ShowString8x16(uint8_t page, uint8_t col, const char *str)
{
    if (str == NULL)
    {
        return;
    }
    while ((*str != '\0') && (col < MOD_OLED_WIDTH))
    {
        MOD_OLED_ShowChar8x16(page, col, *str);
        col = (uint8_t)(col + MOD_OLED_FONT8_WIDTH);
        str++;
    }
}

#endif /* MOD_OLED_ENABLE */
